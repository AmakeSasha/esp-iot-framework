## components/esp_iot_framework_core/Kconfig.projbuild
~~~~kconfig
# SPDX-License-Identifier: Apache-2.0
# Project: esp-iot-framework
# Folder: ./components/esp_iot_framework_core
# File: Kconfig.projbuild
# Library: esp_iot_framework_core
# 
# Copyright 2026 AmakeSasha
# 
# Licensed under the Apache License, Version 2.0 (the "License");
# you may not use this file except in compliance with the License.
# You may obtain a copy of the License at
# 
#     http://www.apache.org/licenses/LICENSE-2.0
# 
# Unless required by applicable law or agreed to in writing, software
# distributed under the License is distributed on an "AS IS" BASIS,
# WITHOUT WARRANTIES OR CONDITIONS OF ANY KIND, either express or implied.
# See the License for the specific language governing permissions and
# limitations under the License.

menu "ESP IoT framework, CORE"
    config EIF_CORE_ENABLE_TLS
        bool "Enable HTTPS (TLS/SSL) Support"
        default y
        select HTTPD_SSL_SUPPORT if EIF_CORE_ENABLE_TLS
        select MBEDTLS_CERTIFICATE_BUNDLE if EIF_CORE_ENABLE_TLS
        select MBEDTLS_TLS_ENABLED if EIF_CORE_ENABLE_TLS
        help
            Switch the web server from insecure HTTP to encrypted HTTPS (Port 443).

            - If enabled: All traffic is fully encrypted using TLS. This provides
              a secure communication channel, preventing "Man-in-the-Middle"
              (MITM) attacks and ensuring that all data remains confidential
              and integral during transit.
            - If disabled: The server operates in plain text mode. ALL DATA
              sent between the client and the device is visible to anyone
              on the same network. Using simple packet sniffers, an attacker
              can easily intercept your session and compromise the system.

            HTTPS is resource-intensive for the ESP32. Enabling this feature
            will result in:
              * Increased RAM consumption (~30-50 KB for TLS buffers).
              * Initial connection latency (1-3 seconds for the TLS handshake).
              * Higher CPU utilization during active data transfer.

            WARNING: Disabling TLS is strongly discouraged for production
                     environments. Modern browsers will mark your admin panel
                     as "Not Secure" and may block access to critical web
                     features.

    config EIF_CORE_ENABLE_BASIC_AUTH
        bool "Enable Basic Authentication for systemic resources"
        default y
        help
            Enables mandatory HTTP Basic Authentication for secure system-level resources,
            administrative endpoints, and protected infrastructure nodes.

            - If enabled: All administrative paths, system REST APIs, and managed assets 
              require a valid username ('admin') and password securely stored in NVS.
            - If disabled: Access control for infrastructure layers is completely bypassed. 
              This may be useful for local debugging or isolated development, but is strongly
              discouraged for deployment.

            WARNING: Disabling authentication exposes system infrastructure endpoints,
            allowing unauthorized access, environment manipulation, and full telemetry
            retrieval.

    menu "Logging Settings"
        config EIF_CORE_LOG_LEVEL
            int "Framework log verbosity"
            range 0 4
            default 3
            help
                Global logging level for all 'esp_iot_framework' modules.
               
                0: None
                1: Error
                2: Warning
                3: Info
                4: Debug

        config EIF_CORE_LOG_SHOW_METADATA
            bool "Show metadata in logs (path, line, function)"
            default n
            help
                If enabled, logs will include the source file, line number,
                and function name.
                
                If enabled:
                ```
                I (8536) HTTPS server: src/web.c:990 (eif_server_launch) HTTP Server started.
                ```
                If disabled:
                ```
                I (8536) HTTPS server: HTTP Server started.
                ```

        config EIF_CORE_LOG_ENABLE_MEM_MONITOR
            bool "Enable memory status logging"
            default n
            help
                If enabled, the current heap status will be printed to the
                console every time the monitor task performs a check
                (defined by 'Memory check interval').

        config EIF_CORE_LOG_ENABLE_REMOTE_DEBUG
            bool "Enable remote diagnostic logging engine"
            default n
            help
                If enabled, Core will intercept all system and business logs 
                into an internal ring buffer. 
                Any Node type (Device, Gateway, Hub, etc.) can then fetch 
                this data via Core API and expose it to the outside world 
                using its own communication protocol (HTTP, MQTT, BLE) 
                for remote diagnostics without a physical UART connection.

        config EIF_CORE_LOG_REMOTE_BUFFER_SIZE
            int "Remote log ring buffer size (bytes)"
            depends on EIF_CORE_LOG_ENABLE_REMOTE_DEBUG
            range 1024 51200
            default 4096
            help
                Size of the internal FreeRTOS ring buffer in RAM.
                4096 bytes can store around 50-70 log lines.
                Higher values consume more heap memory.
    endmenu

    menu "Memory Monitor Settings"
        config EIF_CORE_MEM_MONITOR_CRITICAL_SIZE
            int "The minimum allowed size of the largest block"
            range 12288 65536
            default 12288
            help
                Minimum free block size that must be available for stable operation.
                If the largest free block is smaller than this value, the system
                will reboot.

                WARNING: To ensure the reboot task can be created, this value MUST be
                         at least 8 times larger than EIF_CORE_REBOOT_TASK_STACK_SIZE
                         (which is measured in 4-byte words).

                Formula: CRITICAL_SIZE >= STACK_SIZE * 4 * 2.

                Note: Setting too low may cause missed fragmentation issues; too
                      high may lead to unnecessary reboots.

        config EIF_CORE_MEM_MONITOR_CHECK_INTERVAL
            int "Memory check interval (ms)"
            range 1000 3600000
            default 30000
            help
                How often to check memory fragmentation (in milliseconds).

                This parameter defines the time interval between consecutive memory fragmentation
                checks performed by the memory monitor task.

                The actual time to reboot = CHECK_INTERVAL × NUMBER_CHECKS.

                Examples:
                - 30 000 ms (30 s) + NUMBER_CHECKS=3 → reboot after 90 seconds (1.5 min).
                - 60 000 ms (60 s) + NUMBER_CHECKS=5 → reboot after 300 seconds (5 min).

                WARNING: If the monitor detects fragmentation or low RAM, the scan
                         time is cut in half for more reliable monitoring of the situation.

                         Examples:
                         - Normal state: checks run every 30 seconds.
                         - Critical state: checks accelerate to every 15 seconds.

        config EIF_CORE_MEM_MONITOR_NUMBER_CHECKS
            int "Number of fragmentation confirmations before reboot"
            range 2 60
            default 3
            help
                Number of consecutive memory fragmentation checks that must detect
                a critical condition before the system initiates a safe reboot.

                This parameter prevents false reboots due to temporary memory spikes.
                The system will only trigger a reboot if the largest free memory
                block remains below the critical threshold (EIF_CORE_MEM_MONITOR_CRITICAL_SIZE)
                for the specified number of consecutive checks.

        config EIF_CORE_REBOOT_TASK_STACK_SIZE
            int "Reboot task stack size (words - 4 bytes)"
            range 1536 16384
            default 1536
            help
                Stack size for the task that manages the system shutdown sequence.
               
                The task stops the Wi-Fi driver halts the HTTP server, and
                executes the 'handler_system_reboot' before calling esp_restart().
                Increase this value if 'handler_system_reboot' performs stack-heavy
                operations like NVS writes or complex logging.

                Note: Defined in 4-byte words. The critical block threshold
                     (EIF_CORE_MEM_MONITOR_CRITICAL_SIZE) must be at least 8 times
                     the reboot task stack (or, equivalently, twice the stack size
                     expressed in bytes) so the reboot task can be created in low-memory
                     conditions.

    endmenu
endmenu
~~~~

## components/esp_iot_framework_device/Kconfig.projbuild
```kconfig
# SPDX-License-Identifier: Apache-2.0
# Project: esp-iot-framework
# Folder: ./components/esp_iot_framework_device
# File: Kconfig.projbuild
# Library: esp_iot_framework_device
# 
# Copyright 2026 AmakeSasha
# 
# Licensed under the Apache License, Version 2.0 (the "License");
# you may not use this file except in compliance with the License.
# You may obtain a copy of the License at
# 
#     http://www.apache.org/licenses/LICENSE-2.0
# 
# Unless required by applicable law or agreed to in writing, software
# distributed under the License is distributed on an "AS IS" BASIS,
# WITHOUT WARRANTIES OR CONDITIONS OF ANY KIND, either express or implied.
# See the License for the specific language governing permissions and
# limitations under the License.

menu "ESP IoT Framework, DEVICE"
    menu "Web admin GUI"
        config EIF_ENABLE_WEB_ADMIN_GUI
            bool "Enable Web-based Administration Panel"
            default y
            help
                Enable the integrated web interface for management.
                Only the admin panel, not the user interface!

                - Enabled: All static assets (HTML, CSS, JS) from the 'web_src'
                  directory are embedded directly into the firmware.
                - Disabled: The web interface is completely excluded from the
                  build, providing only the JSON REST API for remote interaction.

                Disabling this feature significantly reduces Flash usage and
                optimizes the HTTP server's memory footprint by stripping
                unnecessary resource-serving logic.

        config EIF_ENABLE_WEB_FAVICON
            bool "Embed Web Favicon (Logo)"
            default y
            depends on EIF_ENABLE_WEB_ADMIN_GUI
            help
                Include the official EIF branding icon in the firmware.

                - Enabled: The PNG favicon is embedded into Flash memory and
                  served automatically on '/favicon.ico' requests.
                - Disabled: Strips the binary image from the firmware, saving
                  extra Flash space and removing the favicon route handler.

        config EIF_WEB_CACHE_MAX_AGE
            int "Static files cache max-age (seconds)"
            range 0 31536000
            default 360
            depends on EIF_ENABLE_WEB_ADMIN_GUI
            help
                Sets the 'max-age' directive for the Cache-Control header.

                During this period, the browser will serve files from its local
                cache without contacting the ESP32. This minimizes CPU and heap
                usage by avoiding HTTPS handshakes and data transmission.

                The 'ETag' validation (If-None-Match) only occurs AFTER this
                timer expires or if the user performs a manual refresh. Setting
                this to 0 is recommended for development to ensure every change
                is immediately visible. For production, a higher value is
                preferable to reduce the load on the MCU.
    endmenu

    config EIF_ENABLE_BASIC_AUTH
        bool "Enable Basic Auth for the core URL (/_/*)"
        default y
        help
            Enables mandatory Basic Authentication for all systemic paths (/_/*).

            - If enabled: All administrative API and Web GUI requests require
              a valid username ('admin') and password stored in NVS.
            - If disabled: Access control is bypassed. It may be useful for local debugging, but it is not recommended.

            WARNING: Disabling authentication can lead to unauthorized access
            and use of the admin panel and the core JSON REST API.

    config EIF_WEB_SIZE_OTA_BUFFER
        int "OTA update buffer size (bytes)"
        range 1024 65536
        default 4096
        help
            Size of the buffer used for receiving OTA firmware updates via HTTP.

            Larger values improve transfer speed but consume more heap memory.
            Smaller values reduce memory usage but may increase transfer time.

            Recommended values:
            - 4096: good balance for most use cases;
            - 8192–16384: for fast transfers when memory is available;
            - 1024–2048: for memory‑constrained environments.

    menu "Logging Settings"
        config EIF_LOG_ENABLE_WEB_SEND_TIMESTAMP
            bool "Include timestamp in HTTP response"
            default n
            help
                When enabled, adds a UNIX timestamp to HTTP responses
                (except 204 No Content). Useful for debugging request timing and
                response latency. Disable in production to reduce response size.
    endmenu
endmenu
```
