## components/esp_iot_framework_device/sdkconfig.defaults
```kconfig
# SPDX-License-Identifier: Apache-2.0
# Project: esp-iot-framework
# Folder: ./components/esp_iot_framework_device
# File: sdkconfig.defaults
# Library: esp_iot_framework_device
# 
# Copyright 2026 AmakeSasha
# 
# Licensed under the Apache License, Version 2.0 (the "License");
# you may not use this file except in compliance with the License.
# You may obtain a copy of the License at
# 
#     http://www.apache.org/licenses/LICENSE-2.0
# 
# Unless required by applicable law or agreed to in writing, software
# distributed under the License is distributed on an "AS IS" BASIS,
# WITHOUT WARRANTIES OR CONDITIONS OF ANY KIND, either express or implied.
# See the License for the specific language governing permissions and
# limitations under the License.

#
# Serial Flasher
#
CONFIG_ESPTOOLPY_FLASHSIZE_4MB=y
CONFIG_ESPTOOLPY_FLASHSIZE="4MB"
# end of `Serial Flasher`

#
# System and Partition
#
CONFIG_ESP_MAIN_TASK_STACK_SIZE=3584
CONFIG_ESP_SYSTEM_EVENT_TASK_STACK_SIZE=4096
CONFIG_PARTITION_TABLE_CUSTOM=n
CONFIG_PARTITION_TABLE_SINGLE_APP=n
CONFIG_PARTITION_TABLE_TWO_OTA=y
CONFIG_PARTITION_TABLE_FILENAME="partitions_two_ota.csv"
# end of `System and Partition`

#
# Bootloader
#
CONFIG_BOOTLOADER_APP_ROLLBACK_ENABLE=y
CONFIG_BOOTLOADER_APP_ANTI_ROLLBACK=n
# end of `Bootloader`

#
# Compiler and Optimizations
#
CONFIG_NEWLIB_NANO_FORMAT=y
CONFIG_COMPILER_OPTIMIZATION_SIZE=y
CONFIG_COMPILER_OPTIMIZATION_ASSERTIONS_DISABLE=y
# end of `Compiler and Optimizations`

#
# ESP-TLS
#
CONFIG_ESP_HTTP_CLIENT_ENABLE_HTTPS=n
CONFIG_ESP_HTTP_CLIENT_ENABLE_BASIC_AUTH=n
CONFIG_ESP_HTTP_CLIENT_ENABLE_DIGEST_AUTH=n
CONFIG_ESP_HTTPS_SERVER_ENABLE=y
CONFIG_ESP_TLS_SERVER_SESSION_TICKETS=n
CONFIG_ESP_TLS_SERVER=y
CONFIG_ESP_TLS_SERVER_SESSION_TICKETS_ENABLE=n
CONFIG_ESP_TLS_PSK_VERIFICATION=n
# end of `ESP-TLS`

#
# HTTP Server (HTTPD)
#
CONFIG_HTTPD_MAX_REQ_HDR_LEN=1024
CONFIG_HTTPD_MAX_URI_LEN=512
CONFIG_HTTPD_WS_SUPPORT=n
CONFIG_HTTPD_IDLE_CTRL_SUPPORT=n
# end of `HTTP Server (HTTPD)`

#
# mbedTLS
#
CONFIG_MBEDTLS_RSA_C=n
CONFIG_MBEDTLS_KEY_EXCHANGE_RSA_ENABLED=n
CONFIG_MBEDTLS_KEY_EXCHANGE_DHE_RSA_ENABLED=n
CONFIG_MBEDTLS_KEY_EXCHANGE_ECDHE_RSA_ENABLED=n
CONFIG_MBEDTLS_ECP_DP_SECP256R1_ENABLED=y
CONFIG_MBEDTLS_ECP_DP_SECP384R1_ENABLED=n
CONFIG_MBEDTLS_ECP_DP_SECP521R1_ENABLED=n
CONFIG_MBEDTLS_SHA1_C=n
CONFIG_MBEDTLS_MD5_C=n
CONFIG_MBEDTLS_MPI_WINDOW_SIZE=3
CONFIG_MBEDTLS_DEBUG=n
CONFIG_MBEDTLS_HARDWARE_MPI=y
CONFIG_MBEDTLS_ERROR_STRERROR_DUMMY=y
CONFIG_MBEDTLS_HAVE_TIME=n
CONFIG_MBEDTLS_HAVE_TIME_DATE=n
CONFIG_MBEDTLS_DYNAMIC_BUFFER_MANAGEMENT=y
CONFIG_MBEDTLS_DYNAMIC_FREE_CA_CERT=y
CONFIG_MBEDTLS_DYNAMIC_FREE_CONFIG_DATA=y
CONFIG_MBEDTLS_SSL_MAX_CONTENT_LEN=2048

# end of `mbedTLS`

#
# mDNS
#
CONFIG_MDNS_STRICT_MODE=n
CONFIG_MDNS_MAX_SERVICES=1
CONFIG_MDNS_PUBLISH_DIFF_HOST=n
# end of `mDNS`

#
# Logging and Error Handling
#
CONFIG_ERR_STR_ENABLE=n
CONFIG_LOG_MAXIMUM_LEVEL_INFO=y
# end of `Logging and Error Handling`

#
# Network Static Isolation
#
CONFIG_ESP_WIFI_STATIC_RX_BUFFER_NUM=10
CONFIG_ESP_WIFI_DYNAMIC_RX_BUFFER_NUM=0
CONFIG_ESP_WIFI_STATIC_TX_BUFFER_NUM=8
CONFIG_ESP_WIFI_DYNAMIC_TX_BUFFER_NUM=0
CONFIG_ESP_WIFI_AMPDU_TX_ENABLED=n
CONFIG_ESP_WIFI_AMPDU_RX_ENABLED=n
CONFIG_LWIP_PBUF_POOL_SIZE=8
# end of `Network Static Isolation`
```

## sdkconfig.defaults
```kconfig
CONFIG_ESPTOOLPY_FLASHSIZE_4MB=y
CONFIG_ESPTOOLPY_FLASHSIZE="4MB"

CONFIG_ESP_MAIN_TASK_STACK_SIZE=16384

CONFIG_BOOTLOADER_APP_ROLLBACK_ENABLE=y
CONFIG_BOOTLOADER_APP_ANTI_ROLLBACK=n

CONFIG_PARTITION_TABLE_CUSTOM=n
CONFIG_PARTITION_TABLE_SINGLE_APP=n
CONFIG_PARTITION_TABLE_TWO_OTA=y
CONFIG_PARTITION_TABLE_FILENAME="partitions_two_ota.csv"

CONFIG_NEWLIB_NANO_FORMAT=y
CONFIG_COMPILER_OPTIMIZATION_SIZE=y
CONFIG_COMPILER_OPTIMIZATION_ASSERTIONS_DISABLE=y

CONFIG_ESP_HTTP_CLIENT_ENABLE_HTTPS=n
CONFIG_ESP_HTTP_CLIENT_ENABLE_BASIC_AUTH=n
CONFIG_ESP_HTTP_CLIENT_ENABLE_DIGEST_AUTH=n
CONFIG_ESP_HTTPS_SERVER_ENABLE=y
CONFIG_ESP_TLS_SERVER_SESSION_TICKETS=y
CONFIG_ESP_TLS_SERVER=y
CONFIG_ESP_TLS_SERVER_SESSION_TICKETS_ENABLE=y
CONFIG_ESP_TLS_PSK_VERIFICATION=n

CONFIG_HTTPD_MAX_REQ_HDR_LEN=1024
CONFIG_HTTPD_MAX_URI_LEN=512
CONFIG_HTTPD_WS_SUPPORT=n
CONFIG_HTTPD_IDLE_CTRL_SUPPORT=n

CONFIG_MBEDTLS_RSA_C=n
CONFIG_MBEDTLS_KEY_EXCHANGE_RSA_ENABLED=n
CONFIG_MBEDTLS_KEY_EXCHANGE_DHE_RSA_ENABLED=n
CONFIG_MBEDTLS_KEY_EXCHANGE_ECDHE_RSA_ENABLED=n
CONFIG_MBEDTLS_ECP_DP_SECP256R1_ENABLED=y
CONFIG_MBEDTLS_ECP_DP_SECP384R1_ENABLED=n
CONFIG_MBEDTLS_ECP_DP_SECP521R1_ENABLED=n
CONFIG_MBEDTLS_SHA1_C=n
CONFIG_MBEDTLS_MD5_C=n
CONFIG_MBEDTLS_MPI_WINDOW_SIZE=3
CONFIG_MBEDTLS_DEBUG=n
CONFIG_MBEDTLS_ERROR_STRERROR_DUMMY=y
CONFIG_MBEDTLS_HAVE_TIME=n
CONFIG_MBEDTLS_HAVE_TIME_DATE=n

CONFIG_MDNS_STRICT_MODE=n
CONFIG_MDNS_MAX_SERVICES=1
CONFIG_MDNS_PUBLISH_DIFF_HOST=n

CONFIG_ERR_STR_ENABLE=n
CONFIG_LOG_MAXIMUM_LEVEL_INFO=y
```
